// SPDX-License-Identifier: GPL-2.0
/*
 * Samsung Exynos7420 SoC device tree source
 * Inherits core exynos7 dtsi, and adds the 4 extra
 * cores that the 7420 has to it.
 *
 * Copyright (C) 2023, Paweł Chmiel <pawel.mikolaj.chmiel@gmail.com>
 * Copyright (C) 2026, schoosh212 <superaviation001@gmail.com>
 */

/dts-v1/;
#include "exynos7.dtsi"
/delete-node/ &hsi2c_7;

/ {
	compatible = "samsung,exynos7420", "samsung,exynos7";
	interrupt-parent = <&gic>;
	#address-cells = <2>;
	#size-cells = <2>;

	arm_a53_pmu {
		compatible = "arm,cortex-a53-pmu";
		interrupts = <GIC_SPI 32 IRQ_TYPE_LEVEL_HIGH>,
			     <GIC_SPI 33 IRQ_TYPE_LEVEL_HIGH>,
			     <GIC_SPI 34 IRQ_TYPE_LEVEL_HIGH>,
			     <GIC_SPI 35 IRQ_TYPE_LEVEL_HIGH>;
		interrupt-affinity = <&cpu_apollo0>, <&cpu_apollo1>,
				     <&cpu_apollo2>, <&cpu_apollo3>;
	};
};

&cpus {
    cpu_apollo0: cpu@100 {
        device_type = "cpu";
        compatible = "arm,cortex-a53";
        reg = <0x100>;
        enable-method = "psci";
    };

    cpu_apollo1: cpu@101 {
        device_type = "cpu";
        compatible = "arm,cortex-a53";
        reg = <0x101>;
        enable-method = "psci";
    };

    cpu_apollo2: cpu@102 {
        device_type = "cpu";
        compatible = "arm,cortex-a53";
        reg = <0x102>;
        enable-method = "psci";
    };

    cpu_apollo3: cpu@103 {
        device_type = "cpu";
        compatible = "arm,cortex-a53";
        reg = <0x103>;
        enable-method = "psci";
    };

&soc {
	hsi2c_7: i2c@14e10000 {
		compatible = "samsung,exynos7-hsi2c";
		reg = <0x14e10000 0x1000>;
		interrupts = <GIC_SPI 462 IRQ_TYPE_LEVEL_HIGH>;
		#address-cells = <1>;
		#size-cells = <0>;
		pinctrl-names = "default";
		pinctrl-0 = <&hs_i2c7_bus>;
		clocks = <&clock_peric1 PCLK_HSI2C7>;
		clock-names = "hsi2c";
		status = "disabled";
	};
};
